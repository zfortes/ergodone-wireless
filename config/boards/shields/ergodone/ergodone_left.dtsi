#include "ergodone.dtsi"

&default_transform {
	col-offset = <1>;
};

/ {
	kscan0: kscan {
        compatible = "zmk,kscan-gpio-matrix";
		label = "KSCAN";
		diode-direction = "row2col";

        col-gpios
            = <&gpio1 4 (GPIO_ACTIVE_HIGH | GPIO_PULL_DOWN)> // coluna 0
            , <&gpio0 11 (GPIO_ACTIVE_HIGH | GPIO_PULL_DOWN)> // coluna 1
            , <&gpio1 0 (GPIO_ACTIVE_HIGH | GPIO_PULL_DOWN)>
            , <&gpio0 24 (GPIO_ACTIVE_HIGH | GPIO_PULL_DOWN)> 
            , <&gpio0 22 (GPIO_ACTIVE_HIGH | GPIO_PULL_DOWN)> // coluna 4
            , <&gpio0 8 (GPIO_ACTIVE_HIGH | GPIO_PULL_DOWN)> // coluna 5
            , <&gpio0 6 (GPIO_ACTIVE_HIGH | GPIO_PULL_DOWN)> // coluna 6
            ;

		row-gpios
			= <&gpio0 31 GPIO_ACTIVE_HIGH>
			, <&gpio0 29 GPIO_ACTIVE_HIGH>
			, <&gpio0  2 GPIO_ACTIVE_HIGH>
			, <&gpio1 15 GPIO_ACTIVE_HIGH>
			, <&gpio1 13 GPIO_ACTIVE_HIGH>
			, <&gpio0 10 GPIO_ACTIVE_HIGH>
			;
	};
};