## app/boards/shields/ergodone/Kconfig.shield
```kconfig
config SHIELD_ERGODONE
    def_bool $(shields_list_contains,ergodone)

config SHIELD_ERGODONE_LEFT
    def_bool $(shields_list_contains,ergodone_left)

config SHIELD_ERGODONE_RIGHT
    def_bool $(shields_list_contains,ergodone_right)
```

## config/Kconfig.shield
```kconfig
config SHIELD_MY_BOARD_LEFT
    def_bool $(shields_list_contains,ergodone_left)

config SHIELD_MY_BOARD_RIGHT
    def_bool $(shields_list_contains,ergodone_right)
```

## config/boards/shields/ergodone/Kconfig.defconfig
```kconfig
if SHIELD_MY_BOARD_LEFT

config ZMK_KEYBOARD_NAME
    default "Ergodone"

config ZMK_SPLIT_ROLE_CENTRAL
    default y

config ZMK_BLE
	default y

config ZMK_USB
	default y

endif

if SHIELD_MY_BOARD_LEFT || SHIELD_MY_BOARD_RIGHT

config ZMK_SPLIT
    default y

endif
```
